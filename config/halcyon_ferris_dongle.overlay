/*
 * Dongle-only devicetree overlay.
 *
 * The right half forwards Cirque touchpad events to the dongle, where
 * &trackpad_listener (from the splitkb mod_cirque_central shield) turns
 * them into mouse movement.
 *
 * - Cursor speed: `&zip_xy_scaler <mul> <div>` multiplies every packet
 *   (2 1 = double, 3 2 = 1.5x). The host's own acceleration applies on top.
 * - Auto mouse layer: `&zip_temp_layer <layer> <timeout-ms>` switches the
 *   Mouse layer (4) on while the pad is moved and off after `timeout-ms`
 *   without movement, so D/F/G are the mouse buttons and E/R scroll while
 *   the finger is on the pad. It does not engage within
 *   `require-prior-idle-ms` of a keystroke (typing), and any key press other
 *   than the ones in `excluded-positions` ends it at once.
 */

#include <input/processors.dtsi>

&zip_temp_layer {
    require-prior-idle-ms = <300>;        /* not while typing */
    excluded-positions = <12 13 14 2 3>;  /* D F G (buttons), E R (scroll) keep it on */
};

&trackpad_listener {
    input-processors = <&zip_xy_scaler 2 1 &zip_temp_layer 4 600>;
};
