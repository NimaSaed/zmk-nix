## modules/drag-lock/Kconfig
```kconfig
DT_COMPAT_ZMK_INPUT_PROCESSOR_DRAG_LOCK := zmk,input-processor-drag-lock

config ZMK_INPUT_PROCESSOR_DRAG_LOCK
    bool "Input processor: clean button transitions + software drag lock"
    default $(dt_compat_enabled,$(DT_COMPAT_ZMK_INPUT_PROCESSOR_DRAG_LOCK))
    depends on ZMK_POINTING

config ZMK_INPUT_PROCESSOR_DRAG_LOCK_TRACE
    bool "Trace drag-lock state transitions at INFO level"
    depends on ZMK_INPUT_PROCESSOR_DRAG_LOCK
    default n

config ZMK_INPUT_PROCESSOR_DRAG_LOCK_STATS
    bool "Log touchpad packet statistics every 5 s at INFO level"
    depends on ZMK_INPUT_PROCESSOR_DRAG_LOCK
    default n
    help
      Counts the packets this processor sees (as delivered to the central):
      torn packets (X/Y/sync triplet incomplete), bare button events,
      packets with a large delta, delivery stalls within a stroke,
      direction flips, and the largest deltas. One summary line per 5 s
      while there is traffic. Used to tell transport problems (torn
      packets, stalls) from the touchpad chip itself reporting garbage
      (intact packets with big deltas / many flips).
```

## modules/drag-lock/dts/bindings/input_processors/zmk,input-processor-drag-lock.yaml
```yaml
description: |
  Input processor for tap-capable touchpads (e.g. cirque,pinnacle in relative
  mode) that forwards only real BTN_TOUCH transitions and adds a software
  drag lock: when a drag ends because the finger was lifted, the button is
  held for `timeout-ms`; if the finger returns and moves within that time the
  drag continues, otherwise the release is sent. Taps without movement are
  forwarded immediately.

  In relative mode the chip reports the lift only for its own tap-drag; for
  a continued (software-held) drag there is no lift signal, so the button is
  released after `soft-drag-idle-ms` without motion.

compatible: "zmk,input-processor-drag-lock"

# One parameter: the button code to emit (e.g. INPUT_BTN_0 for left,
# INPUT_BTN_1 for right; 0 = INPUT_BTN_TOUCH, also left). The code is
# latched when a press is forwarded and reused for its release, so a layer
# (processor chain) change in the middle of a gesture cannot leave ZMK's
# per-button reference count unbalanced.
include: ip_one_param.yaml

properties:
  timeout-ms:
    type: int
    default: 500
    description: |
      How long the button stays held after the finger is lifted mid-drag,
      i.e. the window in which the finger can be put back to continue.
  soft-drag-idle-ms:
    type: int
    default: 1000
    description: |
      In a continued drag, release the button after this long without any
      touchpad motion (covers the finger lifting, which the chip does not
      report in this state; holding still longer than this also ends it).
  tap-drag-window-ms:
    type: int
    default: 500
    description: |
      A button press reported by the chip within this time after a tap this
      processor forwarded is always accepted (double tap, tap-and-hold),
      regardless of the stroke check below.
  tap-after-drag-ms:
    type: int
    default: 350
    description: |
      After a drag was released by the timeout, a motion-less press within
      this time is the tap that was meant to end the drag (the chip reports
      taps 200-300 ms late) and is swallowed instead of clicking.
  stroke-gap-ms:
    type: int
    default: 150
    description: |
      A pause of at least this long between packets ends a cursor stroke.
      Also: a motion-less press while a drag is held only ends the drag if
      no motion arrived for this long; otherwise it is the chip's late tap
      verdict on a short reposition and the drag continues.
  tap-after-stroke-ms:
    type: int
    default: 320
    description: |
      The chip reports a short cursor stroke as a tap about 200-300 ms after
      the finger lifts, and the next touch as a tap-and-drag. A press that
      arrives within this time after the end of a stroke is checked against
      short-stroke-ms and tap-max-stroke; if all match it is swallowed (no
      click, no drag, the motion passes).
  short-stroke-ms:
    type: int
    default: 250
    description: |
      Only strokes that lasted at most this long can have been misread as
      a tap by the chip.
  tap-max-stroke:
    type: int
    default: 24
    description: |
      Only strokes that moved at least this much (sum of |dx| + |dy|) count
      as cursor strokes for the check; smaller motion is a finger roll or
      settling before a real tap (measured 2-17 counts; misread flicks were
      37 and more). 0 disables the check. With TRACE enabled every press
      logs the preceding stroke's size, length and age for tuning.
  drag-threshold:
    type: int
    default: 8
    description: |
      Motion (sum of |dx| + |dy| in counts) that must accumulate while the
      button is reported pressed before the press counts as a drag. Below
      it the press is a tap and its release is forwarded immediately, so a
      slight finger roll during a tap does not arm the drag lock.
```
